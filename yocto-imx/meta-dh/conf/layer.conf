## yocto-imx/meta-dh/conf/layer.conf
```bitbake
# We have a conf and classes directory, add to BBPATH
BBPATH .= ":${LAYERDIR}"

# We have recipes-* directories, add to BBFILES
BBFILES += "${LAYERDIR}/recipes-*/*/*.bb \
            ${LAYERDIR}/recipes-*/*/*.bbappend"

BBFILE_COLLECTIONS += "meta-imx"
BBFILE_PATTERN_meta-imx = "^${LAYERDIR}/"
BBFILE_PRIORITY_meta-imx = "6"

LAYERDEPENDS_meta-imx = "core"
LAYERSERIES_COMPAT_meta-imx = "gatesgarth"
```

## yocto-imx/sources/meta-dhanesh/conf/layer.conf
```bitbake
# We have a conf and classes directory, add to BBPATH
BBPATH .= ":${LAYERDIR}"

# We have recipes-* directories, add to BBFILES
BBFILES += "${LAYERDIR}/recipes-*/*/*.bb \
            ${LAYERDIR}/recipes-*/*/*.bbappend"

BBFILE_COLLECTIONS += "meta-dhanesh"
BBFILE_PATTERN_meta-dhanesh = "^${LAYERDIR}/"
BBFILE_PRIORITY_meta-dhanesh = "6"

LAYERDEPENDS_meta-dhanesh = "core"
LAYERSERIES_COMPAT_meta-dhanesh = "gatesgarth"
```
